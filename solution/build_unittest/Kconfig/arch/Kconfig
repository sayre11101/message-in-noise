## solution/build_unittest/Kconfig/arch/Kconfig
```kconfig
# Load arch Kconfig descriptions.
osource "/zephyrproject/zephyr/arch/x86/Kconfig"
osource "/zephyrproject/zephyr/arch/xtensa/Kconfig"
osource "/zephyrproject/zephyr/arch/sparc/Kconfig"
osource "/zephyrproject/zephyr/arch/riscv/Kconfig"
osource "/zephyrproject/zephyr/arch/posix/Kconfig"
osource "/zephyrproject/zephyr/arch/nios2/Kconfig"
osource "/zephyrproject/zephyr/arch/mips/Kconfig"
osource "/zephyrproject/zephyr/arch/arm64/Kconfig"
osource "/zephyrproject/zephyr/arch/arm/Kconfig"
osource "/zephyrproject/zephyr/arch/arc/Kconfig"
```

## solution/build_unittest/Kconfig/soc/Kconfig.soc
```kconfig
# Load SoC Kconfig descriptions.
osource "/zephyrproject/zephyr/soc/xlnx/zynqmp/Kconfig.soc"
osource "/zephyrproject/zephyr/soc/xlnx/zynq7000/Kconfig.soc"
osource "/zephyrproject/zephyr/soc/xen/Kconfig.soc"
osource "/zephyrproject/zephyr/soc/ti/simplelink/Kconfig.soc"
osource "/zephyrproject/zephyr/soc/ti/lm3s6965/Kconfig.soc"
osource "/zephyrproject/zephyr/soc/ti/k3/Kconfig.soc"
osource "/zephyrproject/zephyr/soc/telink/tlsr/Kconfig.soc"
osource "/zephyrproject/zephyr/soc/starfive/jh71xx/Kconfig.soc"
osource "/zephyrproject/zephyr/soc/st/stm32/Kconfig.soc"
osource "/zephyrproject/zephyr/soc/snps/qemu_arc/Kconfig.soc"
osource "/zephyrproject/zephyr/soc/snps/nsim/arc_v/Kconfig.soc"
osource "/zephyrproject/zephyr/soc/snps/nsim/arc_classic/Kconfig.soc"
osource "/zephyrproject/zephyr/soc/snps/hsdk4xd/Kconfig.soc"
osource "/zephyrproject/zephyr/soc/snps/hsdk/Kconfig.soc"
osource "/zephyrproject/zephyr/soc/snps/emsk/Kconfig.soc"
osource "/zephyrproject/zephyr/soc/snps/emsdp/Kconfig.soc"
osource "/zephyrproject/zephyr/soc/snps/arc_iot/Kconfig.soc"
osource "/zephyrproject/zephyr/soc/silabs/Kconfig.soc"
osource "/zephyrproject/zephyr/soc/sifive/sifive_freedom/Kconfig.soc"
osource "/zephyrproject/zephyr/soc/rockchip/Kconfig.soc"
osource "/zephyrproject/zephyr/soc/renode/riscv_virtual/Kconfig.soc"
osource "/zephyrproject/zephyr/soc/renesas/smartbond/Kconfig.soc"
osource "/zephyrproject/zephyr/soc/renesas/rzt2m/Kconfig.soc"
osource "/zephyrproject/zephyr/soc/renesas/rcar/Kconfig.soc"
osource "/zephyrproject/zephyr/soc/renesas/ra/Kconfig.soc"
osource "/zephyrproject/zephyr/soc/raspberrypi/Kconfig.soc"
osource "/zephyrproject/zephyr/soc/quicklogic/eos_s3/Kconfig.soc"
osource "/zephyrproject/zephyr/soc/qemu/virt_riscv/Kconfig.soc"
osource "/zephyrproject/zephyr/soc/qemu/malta/Kconfig.soc"
osource "/zephyrproject/zephyr/soc/openisa/rv32m1/Kconfig.soc"
osource "/zephyrproject/zephyr/soc/nxp/s32/Kconfig.soc"
osource "/zephyrproject/zephyr/soc/nxp/rw/Kconfig.soc"
osource "/zephyrproject/zephyr/soc/nxp/mcx/Kconfig.soc"
osource "/zephyrproject/zephyr/soc/nxp/lpc/Kconfig.soc"
osource "/zephyrproject/zephyr/soc/nxp/layerscape/Kconfig.soc"
osource "/zephyrproject/zephyr/soc/nxp/kinetis/Kconfig.soc"
osource "/zephyrproject/zephyr/soc/nxp/imxrt/Kconfig.soc"
osource "/zephyrproject/zephyr/soc/nxp/imx/Kconfig.soc"
osource "/zephyrproject/zephyr/soc/nuvoton/numicro/Kconfig.soc"
osource "/zephyrproject/zephyr/soc/nuvoton/numaker/Kconfig.soc"
osource "/zephyrproject/zephyr/soc/nuvoton/npcx/Kconfig.soc"
osource "/zephyrproject/zephyr/soc/nordic/Kconfig.soc"
osource "/zephyrproject/zephyr/soc/neorv32/Kconfig.soc"
osource "/zephyrproject/zephyr/soc/native/inf_clock/Kconfig.soc"
osource "/zephyrproject/zephyr/soc/microchip/miv/Kconfig.soc"
osource "/zephyrproject/zephyr/soc/microchip/mec/Kconfig.soc"
osource "/zephyrproject/zephyr/soc/mediatek/mtk_adsp/Kconfig.soc"
osource "/zephyrproject/zephyr/soc/lowrisc/opentitan/Kconfig.soc"
osource "/zephyrproject/zephyr/soc/litex/litex_vexriscv/Kconfig.soc"
osource "/zephyrproject/zephyr/soc/ite/ec/Kconfig.soc"
osource "/zephyrproject/zephyr/soc/intel/raptor_lake/Kconfig.soc"
osource "/zephyrproject/zephyr/soc/intel/lakemont/Kconfig.soc"
osource "/zephyrproject/zephyr/soc/intel/intel_socfpga_std/Kconfig.soc"
osource "/zephyrproject/zephyr/soc/intel/intel_socfpga/Kconfig.soc"
osource "/zephyrproject/zephyr/soc/intel/intel_niosv/Kconfig.soc"
osource "/zephyrproject/zephyr/soc/intel/intel_ish/Kconfig.soc"
osource "/zephyrproject/zephyr/soc/intel/intel_adsp/Kconfig.soc"
osource "/zephyrproject/zephyr/soc/intel/elkhart_lake/Kconfig.soc"
osource "/zephyrproject/zephyr/soc/intel/atom/Kconfig.soc"
osource "/zephyrproject/zephyr/soc/intel/apollo_lake/Kconfig.soc"
osource "/zephyrproject/zephyr/soc/intel/alder_lake/Kconfig.soc"
osource "/zephyrproject/zephyr/soc/infineon/cat3/Kconfig.soc"
osource "/zephyrproject/zephyr/soc/infineon/cat1b/Kconfig.soc"
osource "/zephyrproject/zephyr/soc/infineon/cat1a/Kconfig.soc"
osource "/zephyrproject/zephyr/soc/gd/gd32/Kconfig.soc"
osource "/zephyrproject/zephyr/soc/gaisler/leon3/Kconfig.soc"
osource "/zephyrproject/zephyr/soc/gaisler/gr716a/Kconfig.soc"
osource "/zephyrproject/zephyr/soc/espressif/Kconfig.soc"
osource "/zephyrproject/zephyr/soc/ene/kb1200/Kconfig.soc"
osource "/zephyrproject/zephyr/soc/efinix/sapphire/Kconfig.soc"
osource "/zephyrproject/zephyr/soc/cdns/xtensa_sample_controller/Kconfig.soc"
osource "/zephyrproject/zephyr/soc/cdns/dc233c/Kconfig.soc"
osource "/zephyrproject/zephyr/soc/brcm/bcmvk/Kconfig.soc"
osource "/zephyrproject/zephyr/soc/brcm/bcm2712/Kconfig.soc"
osource "/zephyrproject/zephyr/soc/brcm/bcm2711/Kconfig.soc"
osource "/zephyrproject/zephyr/soc/atmel/sam0/Kconfig.soc"
osource "/zephyrproject/zephyr/soc/atmel/sam/Kconfig.soc"
osource "/zephyrproject/zephyr/soc/aspeed/Kconfig.soc"
osource "/zephyrproject/zephyr/soc/arm/Kconfig.soc"
osource "/zephyrproject/zephyr/soc/arm/beetle/Kconfig.soc"
osource "/zephyrproject/zephyr/soc/andestech/Kconfig.soc"
osource "/zephyrproject/zephyr/soc/ambiq/Kconfig.soc"
osource "/zephyrproject/zephyr/soc/altr/zephyr_nios2f/Kconfig.soc"
osource "/zephyrproject/zephyr/soc/altr/qemu_nios2/Kconfig.soc"
osource "/zephyrproject/zephyr/soc/adi/max32/Kconfig.soc"
```
